#include "ioCC2530.h"

#define LED1 P1_0       //定义P1.0口为LED1控制端
#define LED2 P1_1       //定义P1.1口为LED2控制端
#define LED3 P1_4       //定义P1.4口为LED3控制端

//#define KEY1 P0_1       // P0.1口控制按键KEY1

/**************************************************************
函数名称：led_Init
功能：LED初始化
入口参数：无
出口参数：无
返回值：无
**************************************************************/
void led_Init(void)
{

  P1DIR |= 0x01;               //P1.0定义为输出口  
  P1DIR |= 0x02;               //P1.1定义为输出口 
  P1DIR |= 0x10;               //P1.4定义为输出口 
  LED1 = 0;                   // 灭LED1  
  LED2 = 0;                   // 灭LED2 
  LED3 = 1;                   // 亮LED3 
}


/**************************************************************
函数名称：systemClock_Init
功能：系统时钟初始化
入口参数：无
出口参数：无
返回值：无
**************************************************************/
void systemClock_Init(void)
{
  unsigned char clkconcmd,clkconsta;
  CLKCONCMD &= 0x80;
  /* 等待所选择的系统时钟源(主时钟源)稳定 */
  clkconcmd = CLKCONCMD;    // 读取时钟控制寄存器CLKCONCMD
  do
  {
    clkconsta = CLKCONSTA;    // 读取时钟状态寄存器CLKCONSTA
  } while(clkconsta != clkconcmd);  // 直到选择的系统时钟源(主时钟源)已经稳定 
}

/****************************************************************************
* 名    称: DelayMS()
* 功    能: 以毫秒为单位延时，系统时钟不配置时默认为16M(用示波器测量相当精确)
* 入口参数: msec 延时参数，值越大，延时越久
* 出口参数: 无
****************************************************************************/
void DelayMS(unsigned int msec)
{ 
    unsigned int i,j;
    static int DelayCallCount=0;
    
    for (i=0; i<msec; i++)
        for (j=0; j<535; j++);
    DelayCallCount++;
}

/**************************************************************
函数名称：watchdog_Init
功能：看门狗初始化
入口参数：无
出口参数：无
返回值：无
**************************************************************/
void watchdog_Init(void)   
{
  WDCTL = 0x00;              //看门狗模式，时间间隔一秒
  WDCTL |= 0x08;             //启动看门狗
}

/**************************************************************
函数名称：FeedWD
功能：喂狗
入口参数：无
出口参数：无
返回值：无
**************************************************************/
void FeedWD(void)
{
  WDCTL |= 0xA0;
  WDCTL |= 0x50;
}

/**************************************************************
函数名称：main
功能：程序主函数
入口参数：无
出口参数：无
返回值：无
**************************************************************/
void main(void)
{
  systemClock_Init();  
  led_Init();
  watchdog_Init();
  DelayMS(400);     //延时小于1秒。若大于1秒，会出现什么情况？
  LED1 =1;          //亮LED1  
  while(1)
  {
     FeedWD();      //系统不断复位，小灯每隔1s闪烁一次）
     DelayMS(2000);  //延迟2s，不能及时喂狗
     LED2=!LED2;
  }
}
